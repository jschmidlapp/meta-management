## conf/layer.conf
```bitbake
# We have a conf and classes directory, add to BBPATH
BBPATH := "${BBPATH}:${LAYERDIR}"

# We have a recipes directory, add to BBFILES
BBFILES := "${BBFILES} ${LAYERDIR}/recipes-services/*/*.bb \
            ${BBFILES} ${LAYERDIR}/recipes-luci/*/*.bb \
            ${BBFILES} ${LAYERDIR}/recipes-config/*/*.bb \ 
            ${LAYERDIR}/recipes-services/*/*.bbappend"

BBFILE_COLLECTIONS += "appliance"
BBFILE_PATTERN_appliance := "^${LAYERDIR}/"
BBFILE_PRIORITY_appliance = "1"
```
